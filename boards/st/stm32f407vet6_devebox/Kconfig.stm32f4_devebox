## boards/st/stm32f407vet6_devebox/Kconfig.stm32f4_devebox
```kconfig
# Copyright (c) 2016 Linaro Limited.
# SPDX-License-Identifier: Apache-2.0

config BOARD_STM32F4_DEVEBOX
	select SOC_STM32F407XE
```

## boards/st/stm32f407vet6_devebox/board.yml
```yaml
board:
  name: stm32f4_devebox
  full_name: STM32F4 DevEBox
  vendor: st
  socs:
    - name: stm32f407xx
```
